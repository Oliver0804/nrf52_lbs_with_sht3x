## boards/lapita_board/Kconfig.defconfig
```kconfig
# Copyright (c) 2023 Nordic Semiconductor ASA
# SPDX-License-Identifier: Apache-2.0

if BOARD_LAPITA_BOARD

config BOARD
	default "lapita_board"

config BT_CTLR
   default BT

endif
```
